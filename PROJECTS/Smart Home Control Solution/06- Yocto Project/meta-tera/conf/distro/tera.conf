## PROJECTS/Smart Home Control Solution/06- Yocto Project/meta-tera/conf/distro/tera.conf
```bitbake
MAINTAINER = "TERA <eng.mostafa.tera@gmail.com>"
require conf/distro/poky.conf
DISTRO = "tera"
DISTRO_NAME = "TERA distro"
DISTRO_VERSION = "1.0"
# DISTRO_FEATURES:append = " x11 pam wayland opengl"
DISTRO_FEATURES:append = " systemd package-management V412 wifi"
#INIT_MANAGER = "systemd"
# VIRTUAL-RUNTIME_init_manager = "weston"
```

## PROJECTS/Smart Home Control Solution/06- Yocto Project/meta-tera/conf/layer.conf
```bitbake
# We have a conf and classes directory, add to BBPATH
BBPATH .= ":${LAYERDIR}"

# We have recipes-* directories, add to BBFILES
BBFILES += "${LAYERDIR}/recipes-*/*/*.bb \
            ${LAYERDIR}/recipes-*/*/*.bbappend"

BBFILE_COLLECTIONS += "meta-tera"
BBFILE_PATTERN_meta-tera = "^${LAYERDIR}/"
BBFILE_PRIORITY_meta-tera = "7"

LAYERDEPENDS_meta-tera = "core"
LAYERSERIES_COMPAT_meta-tera = "kirkstone"
```
